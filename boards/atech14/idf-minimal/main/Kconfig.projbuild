## boards/atech14/idf-minimal/main/Kconfig.projbuild
```kconfig
menu "Atech Sim"
    config ATECH_LED_GPIO
        int "LED GPIO"
        default 4
    config ATECH_BUTTON_GPIO
        int "Button GPIO (active low, internal pull-up)"
        default 5
    config ATECH_WIFI_ENABLE
        bool "Connect to WiFi at boot"
        default y
    config ATECH_WIFI_SSID
        string "WiFi SSID"
        default "Wokwi-GUEST"
        depends on ATECH_WIFI_ENABLE
    config ATECH_WIFI_PASS
        string "WiFi password"
        default ""
        depends on ATECH_WIFI_ENABLE
endmenu
```

## examples/wifi-station/sdkconfig.defaults
```kconfig
CONFIG_ESP_WIFI_SOFTAP_SUPPORT=n
CONFIG_ESP_WIFI_SSID="esp32sim"
CONFIG_ESP_WIFI_PASSWORD=""
CONFIG_ESP_CONSOLE_USB_SERIAL_JTAG=y
CONFIG_ESP_CONSOLE_UART_DEFAULT=n
CONFIG_ESP_WIFI_AUTH_OPEN=y
```
